## app/Kconfig
```kconfig
menuconfig LED_SUBSYSTEM
	bool "LED Subsystem"
	default y

if LED_SUBSYSTEM

choice
	prompt "LED blink sleep time"
	default BLINK_SLEEP_1000MS

config BLINK_SLEEP_250MS
	bool "250ms (fast)"

config BLINK_SLEEP_1000MS
	bool "1s (medium)"

config BLINK_SLEEP_2000MS
	bool "2s (slow)"
endchoice

menuconfig LED_ADVANCED
	bool "Advanced LED settings"
	default n

if LED_ADVANCED

config LED_BRIGHTNESS
int "LED brightness (0-100)"
default 100
range 0 100

config LED_FADE
int "LED fade duration (ms)"
default 500

menu "Expert settings"

config LED_DEBUG
	bool "Enable LED debugging"

config LED_CUSTOM
	bool "Custom blink pattern"

endmenu

endif # LED_ADVANCED

endif # LED_SUBSYSTEM

source "Kconfig.zephyr"
```
